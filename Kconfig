## Kconfig
```kconfig
# Electronya Zephyr Wrapper
# Copyright (C) 2023 by Electronya

config ENYA_ZEPHYR_WRAPPER
        bool "Electronya Zephyr Wrapper."
        default n
        help
            Enable the usage of the Electronya Zephyr Wrapper.

config ENYA_GPIO
        bool "GPIO wrapper"
        default n
        depends on ENYA_ZEPHYR_WRAPPER && GPIO
        help
            Enable the GPIO wrapper.

config ENYA_COUNTER
        bool "counter wrapper"
        default n
        depends on ENYA_ZEPHYR_WRAPPER && COUNTER
        help
            Enable the counter wrapper.

config ENYA_LED_STRIP
        bool "LED strip wrapper"
        default n
        depends on ENYA_ZEPHYR_WRAPPER && ENYA_GPIO && ENYA_COUNTER
        help
            Enable the LED strip wrapper.

config ENYA_USB
        bool "USB wrapper"
        default n
        depends on ENYA_ZEPHYR_WRAPPER
        help
            Enable the USB wrapper. IMPORTANT: This has USB_DEVICE_STACK as a
            dependencies, but it's in the depends on for testing purpose.

config ENYA_USB_ACM
        bool "USB ACM wrapper"
        default n
        depends on ENYA_USB
        help
            Enable the USB CDC ACM wrapper.

config ENYA_USB_HID
        bool "USB HID wrapper"
        default n
        depends on ENYA_USB
        help
          Enable the USB HID wrapper.
```
